/dts-v1/;
#include "rk3588.dtsi"
#include "rk3588-u-boot.dtsi"
#include <dt-bindings/input/input.h>

/ {
	model = "RK3588S NanoPi R6C";
	compatible = "rockchip,rk3588s-nanopi-r6c", "rockchip,rk3588";
};
